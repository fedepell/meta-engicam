## conf/machine/gwcv4.conf
```bitbake
#@TYPE: Machine
#@SOC: i.MX6ULL
#@NAME: engicam based gwcv4
#@DESCRIPTION: Machine configuration for Higeco GWCv4

include conf/machine/include/geamx6.inc

# For 512Mb flash
#UBINIZE_ARGS = "-m 4096 -p 256KiB -s 2048"
#MKUBIFS_ARGS = "-m 4096 -e 253952 -c 1944"

# For 256MB flash
UBINIZE_ARGS = "-m 2048 -p 128KiB -s 2048"
MKUBIFS_ARGS = "-m 2048 -e 126976 -c 1944"

KERNEL_DEVICETREE = "nxp/imx/microgea-mx6ull-gwcv4-dts1.dtb nxp/imx/microgea-mx6ull-gwcv4-dts2.dtb"

UBOOT_CONFIG ??= "sdcard"

# This would use the imx one, but is currently not working
#PREFERRED_PROVIDER_u-boot = "u-boot-imx"
#PREFERRED_PROVIDER_virtual/bootloader = "u-boot-imx"
#UBOOT_CONFIG[sdcard] = "imx6ul_geam_mmc_config"
#UBOOT_CONFIG_IMAGE_FSTYPES[sdcard] = "sdcard"
#UBOOT_CONFIG_BINARY[sdcard] = "u-boot-with-spl.imx"
#UBOOT_CONFIG[nand] = "imx6ul_geam_nand_config"
#UBOOT_CONFIG_BINARY[nand] = "u-boot-with-spl.imx"

# Use Engicam one
PREFERRED_PROVIDER_u-boot = "u-boot-eng"
PREFERRED_PROVIDER_virtual/bootloader = "u-boot-eng"
UBOOT_CONFIG[sdcard] = "microgea_mx6ull_sd_defconfig"
UBOOT_CONFIG_IMAGE_FSTYPES[sdcard] = "sdcard"
UBOOT_CONFIG_BINARY[sdcard] = "u-boot-dtb.imx"
UBOOT_CONFIG[nand] = "microgea_mx6ull_nand_defconfig"
UBOOT_CONFIG_IMAGE_FSTYPES[nand] = "nand"
UBOOT_CONFIG_BINARY[nand] = "u-boot-dtb.imx"

UBOOT_SUFFIX = "bin"
UBOOT_ENTRYPOINT = "0x80008000"

SERIAL_CONSOLE = "115200 ttymxc0"

MACHINE_FIRMWARE:remove = " firmware-imx-epdc firmware-imx-vpu-imx6q firmware-imx-vpu-imx6d linux-firmware-imx-sdma-imx6q linux-firmware-imx-sdma-imx7d"

MACHINEOVERRIDES:append = ":mx6ull"

CORE_IMAGE_EXTRA_INSTALL:append = "kernel-modules"

DISTRO_FEATURES:append = " systemd systemd-serialgetty usrmerge"
VIRTUAL-RUNTIME_init_manager = "systemd"
VIRTUAL-RUNTIME_initscripts = "systemd-compat-units"
PACKAGECONFIG:append_pn-systemd = " resolved networkd"

# Remove some features really not needed for GWCv4
DISTRO_FEATURES:remove = " alsa pcmcia pci opengl pulseaudio x11 nfc 3g bluetooth opengl ptest vulkan wayland sysvinit"

# Do not install kernel image in /boot: we have it raw in NAND and on separate partition on SD
RDEPENDS:${KERNEL_PACKAGE_NAME}-base = ""

#PREFERRED_PROVIDER_virtual/kernel = "linux-fslc-imx"
#PREFERRED_VERSION_linux-fslc = "6.18%"
PREFERRED_PROVIDER_virtual/kernel = "linux-fslc"
PREFERRED_VERSION_linux-fslc = "6.12%"

# Use NXP firmware blobs
IMX_USE_LINUX_FIRMWARE_SDMA = "0"
```

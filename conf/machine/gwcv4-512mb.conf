## conf/machine/gwcv4-512mb.conf
```bitbake
#@TYPE: Machine
#@SOC: i.MX6ULL
#@NAME: engicam based gwcv4 512Mb
#@DESCRIPTION: Machine configuration for Higeco GWCv4, variant with 512Mb flash

# Use everything from base GWCv4, just override hardware changes here
include conf/machine/gwcv4.conf

MACHINEOVERRIDES = "mx6:mx6ull:gea:gwcv4:"

# For 512Mb flash
UBINIZE_ARGS = "-m 4096 -p 256KiB -s 2048"
MKUBIFS_ARGS = "-m 4096 -e 253952 -c 1944"
```
